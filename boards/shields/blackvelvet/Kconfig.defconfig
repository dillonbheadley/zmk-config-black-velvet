## boards/shields/blackvelvet/Kconfig.defconfig
```kconfig
if SHIELD_BLACK_VELVET_LEFT

config ZMK_KEYBOARD_NAME
    default "Black Velvet"

config ZMK_SPLIT_ROLE_CENTRAL
    default y

endif

if SHIELD_BLACK_VELVET_LEFT || SHIELD_BLACK_VELVET_RIGHT

config ZMK_SPLIT
    default y

endif
```

## config/boards/shields/blackvelvet/Kconfig.shield
```kconfig
config SHIELD_BLACK_VELVET_LEFT
    def_bool $(shields_list_contains,blackvelvet_left)

config SHIELD_BLACK_VELVET_RIGHT
    def_bool $(shields_list_contains,blackvelvet_right)
```
